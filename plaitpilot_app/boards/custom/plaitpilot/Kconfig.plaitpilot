## plaitpilot_app/boards/custom/plaitpilot/Kconfig.plaitpilot
```kconfig
# defines the BOARD_PLAITPLIOT symbol and selects the esp 32 wroom 32ue and the pro cpu,  

config BOARD_PLAITPILOT
    # TODO: why is this like this??
	select SOC_ESP32S3_WROOM_N8
	select SOC_ESP32S3_PROCPU if BOARD_ESP32S3_DEVKITC_ESP32S3_PROCPU
```

## plaitpilot_app/boards/custom/plaitpilot/plaitpilot_propcpu_defconfig
```kconfig
# default configurations for pre-existing kconfig symbols
# Basically what this means is for this custom board, when using only the propcpu within the esp32 (dualcore normally), you need these configurations for the board to work by default, hence "def" and "config".
CONFIG_MAIN_STACK_SIZE=2048
CONFIG_CONSOLE=y
CONFIG_SERIAL=y
CONFIG_UART_CONSOLE=y
CONFIG_GPIO=y
CONFIG_CLOCK_CONTROL=y 
```
